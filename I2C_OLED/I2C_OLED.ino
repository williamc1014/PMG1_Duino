#include <LiquidCrystal.h>

#include <Wire.h>


uint8_t initCmd[]={0xAE, 0x00, 0x10, 0x40, 0xB0, 0x81, 0xFF, 0xA1, 0xA6, 0xA8, 0x3F, 0xC8, 0xD3, 0x00, 0xD5, 0x80, 0xD8, 0x05, 0xD9, 0xF1, 0xDA, 0x12, 0xD8, 0x30, 0x8D, 0x14, 0xAF};
//uint8_t initCmd[]={0xAE, 0x00, 0x10, 0x40, 0xB0, 0x81, 0xCF, 0xA1, 0xA6, 0xA8, 0x3F, 0xC8, 0xD3, 0x00, 0xD5, 0x80, 0xD9, 0xF1, 0xDA, 0x12, 0xDB, 0x40, 0x8D, 0x14, 0xAF};
//uint8_t initCmd[]={0xAE, 0x02, 0x10, 0x40, 0xB0, 0x81, 0x80, 0xA1, 0xA6, 0xA8, 0x3F, 0xAD, 0x8B, 0x30, 0xC8, 0xD3, 0x00, 0xD5, 0x80, 0xD9, 0x1F, 0xDA, 0x12, 0xDB, 0x40, 0xAF};
//https://github.com/Infineon/XMC-for-Arduino/releases/latest/download/package_infineon_index.json
//https://github.com/williamc1014/PMG1_Duino/releases/download/V0.0.1/package_PMG1_index.json

const unsigned char F6x8[][6] =
{
    { 0x00, 0x00, 0x00, 0x00, 0x00, 0x00 },   // sp 0
    { 0x00, 0x00, 0x00, 0x2f, 0x00, 0x00 },   // !  1
    { 0x00, 0x00, 0x07, 0x00, 0x07, 0x00 },   // "  2
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    { 0x14, 0x14, 0x14, 0x14, 0x14, 0x14 }    // horiz lines
};

const unsigned char F8x16[]=
{
  0x00,0x00,0x00,0x00,0x00,0x00,0x00,0x00,0x00,0x00,0x00,0x00,0x00,0x00,0x00,0x00,// 0
  0x00,0x00,0x00,0xF8,0x00,0x00,0x00,0x00,0x00,0x00,0x00,0x33,0x30,0x00,0x00,0x00,//! 1
  0x00,0x10,0x0C,0x06,0x10,0x0C,0x06,0x00,0x00,0x00,0x00,0x00,0x00,0x00,0x00,0x00,//" 2
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  0x00,0x06,0x01,0x01,0x02,0x02,0x04,0x04,0x00,0x00,0x00,0x00,0x00,0x00,0x00,0x00,//~ 94
};

void lcdWriteCmd(uint8_t data)
{
  Wire.beginTransmission(0x3C);
  Wire.write(0x00);
  Wire.write(data);
  Wire.endTransmission();
}

void lcdWriteData(uint8_t data)
{
  Wire.beginTransmission(0x3C);
  Wire.write(0x40);
  Wire.write(data);
  Wire.endTransmission();  
}

void lcdSetPos(uint8_t x, uint8_t y)
{
  lcdWriteCmd(0xB0 + y);
  lcdWriteCmd(((x & 0xF0) >> 4) | 0x10);
  lcdWriteCmd((x & 0x0F) | 0x01);
}

void lcdFillScreen(uint8_t data)
{
  uint8_t x,y;

  lcdWriteCmd(0x02);    /*set lower column address*/       
  lcdWriteCmd(0x10);    /*set higher column address*/
  lcdWriteCmd(0xB0);    /*set page address*/
     
  for(y=0; y<8; y++)
  {
    lcdWriteCmd(0xB0+y);    /*set page address*/
    lcdWriteCmd(0x00);    /*set lower column address*/       
    lcdWriteCmd(0x10);    /*set higher column address*/
    for(x=0; x<128; x++)
      lcdWriteData(data);
  }  
}

void lcdShowChar(uint8_t x, uint8_t y, uint8_t index, uint8_t size)
{
	uint8_t c = 0;
  uint8_t i = 0;	
	
  c = index - 0x20;			
	if (x > (128-1))
  { 
    x=0;
    y=y+2;
  }
	
  if(size ==16)
	{
		lcdSetPos(x, y);	
		
    for(i=0; i<8; i++)
			lcdWriteData(F8x16[c*16+i]);
		
    lcdSetPos(x, y+1);
		
    for(i=0;i <8; i++)
			lcdWriteData(F8x16[c*16+i+8]);
	}
	else 
  {	
		lcdSetPos(x, y);
		for(i=0; i<6; i++)
			lcdWriteData(F6x8[c][i]);
				
	}
}

unsigned int lcdPow(uint8_t m,uint8_t n)
{
	unsigned int result=1;	 
	while(n--)result*=m;    
	return result;
}

void lcdShowNum(uint8_t x, uint8_t y, uint8_t num)
{
	uint8_t t,temp;
	uint8_t enshow=0;						   
	for(t=0; t<3; t++)
	{
		temp = (num / lcdPow(10, 3-t-1)) % 10;
		if(enshow==0 && t<(3-1))
		{
			if(temp==0)
			{
				lcdShowChar(x+(16/2)*t,y,' ',16);
				continue;
			}else enshow=1; 
		 	 
		}
	 	lcdShowChar(x+(16/2)*t,y,temp+'0',16); 
	}
}


void setup() {
  pinMode(2, OUTPUT);
  digitalWrite(LED_BUILTIN, 1);
  Wire.begin();
  
  for (uint8_t i=0; i<27; i++)
  {
    lcdWriteCmd(initCmd[i]);
  }  

  lcdFillScreen(0);
}

uint8_t count = 0;

void loop() {

  //lcdFillScreen(0);
  //lcdShowChar(0, 0, ((count % 10)+0x30), 16);  
  lcdShowNum(0, 0, count);
  lcdShowNum(0, 6, count);
  count ++;
  delay(1000);
}